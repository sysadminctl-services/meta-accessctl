## conf/distro/accessctl-linux.conf
```bitbake
DISTRO = "accessctl-linux"
DISTRO_NAME = "AccessCTL Embedded Linux"
DISTRO_VERSION = "1.0"
DISTRO_CODENAME = "alpha"
DISTRO_FEATURES:append = " opengl x11 wayland"
```

## conf/layer.conf
```bitbake
# We have a conf and classes directory, add to BBPATH
BBPATH .= ":${LAYERDIR}"

# We have recipes-* directories, add to BBFILES
BBFILES += "${LAYERDIR}/recipes-*/*/*.bb \
            ${LAYERDIR}/recipes-*/*/*.bbappend"

BBFILE_COLLECTIONS += "meta-accessctl"
BBFILE_PATTERN_meta-accessctl = "^${LAYERDIR}/"
BBFILE_PRIORITY_meta-accessctl = "6"

LAYERDEPENDS_meta-accessctl = "core meta-python networking-layer"
LAYERSERIES_COMPAT_meta-accessctl = "scarthgap"
```
